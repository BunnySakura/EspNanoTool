## sdkconfig.defaults
```kconfig
#
# Wi-Fi
#
# CONFIG_ESP_WIFI_STA_DISCONNECTED_PM_ENABLE is not set
CONFIG_ESP_WIFI_DPP_SUPPORT=y

#
# LVGL TFT Display controller
#
CONFIG_LV_PREDEFINED_DISPLAY_M5STACK=y
CONFIG_LV_HOR_RES_MAX=320
CONFIG_LV_VER_RES_MAX=240
CONFIG_LV_DISPLAY_ORIENTATION_LANDSCAPE=y
CONFIG_LV_INVERT_COLORS=y

#
# Color settings
#
CONFIG_LV_COLOR_16_SWAP=y

#
# 3rd Party Libraries
#
CONFIG_LV_USE_QRCODE=y

# Deprecated options for backward compatibility
CONFIG_WPA_DPP_SUPPORT=y
```
